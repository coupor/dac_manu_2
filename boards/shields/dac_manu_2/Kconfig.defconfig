## boards/shields/dac_manu_2/Kconfig.defconfig
```kconfig
if SHIELD_DAC_MANU_2

# Name must be less than 16 characters long!
config ZMK_KEYBOARD_NAME
    default "Dac Manu 2"

endif
```

## config/west.yml
```yaml
manifest:
  remotes:
    - name: zmkfirmware
      url-base: https://github.com/zmkfirmware
    # Additional modules containing boards/shields/custom code can be listed here as well
    # See https://docs.zephyrproject.org/3.2.0/develop/west/manifest.html#projects
    - name: dac_manu_2_base
      url-base: https://github.com/coupor
  projects:
    - name: zmk
      remote: zmkfirmware
      revision: main
      import: app/west.yml
    - name: dac_manu_2
      remote: dac_manu_2_base
      revision: main
      import: west.yml
  self:
    path: config
```
